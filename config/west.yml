## config/west.yml
```yaml
manifest:
  remotes:
    - name: zmkfirmware
      url-base: https://github.com/zmkfirmware
    - name: rizalfr
      url-base: https://github.com/rizalfr
  projects:
    - name: zmk
      remote: rizalfr
      revision: quefrency_v1
      import: app/west.yml
  self:
    path: config
```
